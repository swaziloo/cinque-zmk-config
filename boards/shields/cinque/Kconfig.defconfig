## boards/shields/cinque/Kconfig.defconfig
```kconfig
if SHIELD_CINQUE_LEFT

config ZMK_KEYBOARD_NAME
    default "cinque"

config ZMK_SPLIT_ROLE_CENTRAL
    default y
endif

if SHIELD_CINQUE_LEFT || SHIELD_CINQUE_RIGHT

config ZMK_SPLIT
    default y

endif
```

## boards/shields/cinque/Kconfig.shield
```kconfig
config SHIELD_CINQUE_LEFT
    def_bool $(shields_list_contains,cinque_left)

config SHIELD_CINQUE_RIGHT
    def_bool $(shields_list_contains,cinque_right)
```
